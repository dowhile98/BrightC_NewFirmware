## temp/brightc_h743zi/board.yml
```yaml
board:
  name: brightc_h743zi
  full_name: BrightC-B1 H743ZI BaseBoard V3
  vendor: daecge
  socs:
    - name: stm32h743xx
```

## tests/lib/custom/testcase.yaml
```yaml
common:
  tags: extensibility
  integration_platforms:
    - brightc-controllerv3
tests:
  lib.custom: {}
  lib.custom.non_default:
    extra_args: CONFIG_CUSTOM_GET_VALUE_DEFAULT=6
```

## west.yml
```yaml
# Copyright (c) 2021 Nordic Semiconductor ASA
# SPDX-License-Identifier: Apache-2.0

manifest:
  self:
    west-commands: scripts/west-commands.yml

  remotes:
    - name: zephyrproject-rtos
      url-base: https://github.com/zephyrproject-rtos

  projects:
    - name: zephyr
      remote: zephyrproject-rtos
      revision: v4.4.2
      import:
        # By using name-allowlist we can clone only the modules that are
        # strictly needed by the application.
        name-allowlist:
          - cmsis_6    # required by the ARM port for Cortex-M
          - hal_nordic # required by the custom_plank board (Nordic based)
          - hal_stm32  # required by STM32 based boards
          - fatfs
          - mbedtls
          - mldsa-native
          - tf-psa-crypto
          - mipi-sys-t
          - percepio
          - segger
          - lvgl
          - zcbor
          - cmsis-dsp
          - cmsis-nn
    - name: microconf
      url: https://github.com/dowhile98/microconf.git
      revision: master
      path: modules/lib/microconf
```
