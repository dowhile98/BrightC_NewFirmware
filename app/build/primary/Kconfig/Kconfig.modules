## app/build/primary/Kconfig/soc/Kconfig.defconfig
```kconfig
# Load Zephyr SoC defconfig descriptions.
osource "/media/tecna/disk11/linux/embedded-mcu/BrightC_Workspace/zephyr/soc/xlnx/zynqmp/Kconfig.defconfig"
osource "/media/tecna/disk11/linux/embedded-mcu/BrightC_Workspace/zephyr/soc/xlnx/zynq7000/Kconfig.defconfig"
osource "/media/tecna/disk11/linux/embedded-mcu/BrightC_Workspace/zephyr/soc/xlnx/versalnet/Kconfig.defconfig"
osource "/media/tecna/disk11/linux/embedded-mcu/BrightC_Workspace/zephyr/soc/xlnx/versal2/Kconfig.defconfig"
osource "/media/tecna/disk11/linux/embedded-mcu/BrightC_Workspace/zephyr/soc/xlnx/versal/Kconfig.defconfig"
osource "/media/tecna/disk11/linux/embedded-mcu/BrightC_Workspace/zephyr/soc/xen/Kconfig.defconfig"
osource "/media/tecna/disk11/linux/embedded-mcu/BrightC_Workspace/zephyr/soc/wch/ch32v/Kconfig.defconfig"
osource "/media/tecna/disk11/linux/embedded-mcu/BrightC_Workspace/zephyr/soc/ti/tiva_c/Kconfig.defconfig"
osource "/media/tecna/disk11/linux/embedded-mcu/BrightC_Workspace/zephyr/soc/ti/simplelink/Kconfig.defconfig"
osource "/media/tecna/disk11/linux/embedded-mcu/BrightC_Workspace/zephyr/soc/ti/mspm/Kconfig.defconfig"
osource "/media/tecna/disk11/linux/embedded-mcu/BrightC_Workspace/zephyr/soc/ti/lm3s6965/Kconfig.defconfig"
osource "/media/tecna/disk11/linux/embedded-mcu/BrightC_Workspace/zephyr/soc/ti/k3/Kconfig.defconfig"
osource "/media/tecna/disk11/linux/embedded-mcu/BrightC_Workspace/zephyr/soc/ti/am13/Kconfig.defconfig"
osource "/media/tecna/disk11/linux/embedded-mcu/BrightC_Workspace/zephyr/soc/telink/tlsr/Kconfig.defconfig"
osource "/media/tecna/disk11/linux/embedded-mcu/BrightC_Workspace/zephyr/soc/syna/sr100/Kconfig.defconfig"
osource "/media/tecna/disk11/linux/embedded-mcu/BrightC_Workspace/zephyr/soc/starfive/jh71xx/Kconfig.defconfig"
osource "/media/tecna/disk11/linux/embedded-mcu/BrightC_Workspace/zephyr/soc/st/stm32/Kconfig.defconfig"
osource "/media/tecna/disk11/linux/embedded-mcu/BrightC_Workspace/zephyr/soc/snps/qemu_arc/Kconfig.defconfig"
osource "/media/tecna/disk11/linux/embedded-mcu/BrightC_Workspace/zephyr/soc/snps/nsim/arc_v/Kconfig.defconfig"
osource "/media/tecna/disk11/linux/embedded-mcu/BrightC_Workspace/zephyr/soc/snps/nsim/arc_classic/Kconfig.defconfig"
osource "/media/tecna/disk11/linux/embedded-mcu/BrightC_Workspace/zephyr/soc/snps/hsdk4xd/Kconfig.defconfig"
osource "/media/tecna/disk11/linux/embedded-mcu/BrightC_Workspace/zephyr/soc/snps/hsdk/Kconfig.defconfig"
osource "/media/tecna/disk11/linux/embedded-mcu/BrightC_Workspace/zephyr/soc/snps/emsk/Kconfig.defconfig"
osource "/media/tecna/disk11/linux/embedded-mcu/BrightC_Workspace/zephyr/soc/snps/emsdp/Kconfig.defconfig"
osource "/media/tecna/disk11/linux/embedded-mcu/BrightC_Workspace/zephyr/soc/snps/arc_iot/Kconfig.defconfig"
osource "/media/tecna/disk11/linux/embedded-mcu/BrightC_Workspace/zephyr/soc/silabs/Kconfig.defconfig"
osource "/media/tecna/disk11/linux/embedded-mcu/BrightC_Workspace/zephyr/soc/sifli/sf32/Kconfig.defconfig"
osource "/media/tecna/disk11/linux/embedded-mcu/BrightC_Workspace/zephyr/soc/sifive/sifive_freedom/Kconfig.defconfig"
osource "/media/tecna/disk11/linux/embedded-mcu/BrightC_Workspace/zephyr/soc/shakti/Kconfig.defconfig"
osource "/media/tecna/disk11/linux/embedded-mcu/BrightC_Workspace/zephyr/soc/sensry/Kconfig.defconfig"
osource "/media/tecna/disk11/linux/embedded-mcu/BrightC_Workspace/zephyr/soc/rockchip/Kconfig.defconfig"
osource "/media/tecna/disk11/linux/embedded-mcu/BrightC_Workspace/zephyr/soc/renode/riscv_virtual/Kconfig.defconfig"
osource "/media/tecna/disk11/linux/embedded-mcu/BrightC_Workspace/zephyr/soc/renode/cortex_r8_virtual/Kconfig.defconfig"
osource "/media/tecna/disk11/linux/embedded-mcu/BrightC_Workspace/zephyr/soc/renesas/smartbond/Kconfig.defconfig"
osource "/media/tecna/disk11/linux/embedded-mcu/BrightC_Workspace/zephyr/soc/renesas/rz/Kconfig.defconfig"
osource "/media/tecna/disk11/linux/embedded-mcu/BrightC_Workspace/zephyr/soc/renesas/rx/Kconfig.defconfig"
osource "/media/tecna/disk11/linux/embedded-mcu/BrightC_Workspace/zephyr/soc/renesas/rcar/Kconfig.defconfig"
osource "/media/tecna/disk11/linux/embedded-mcu/BrightC_Workspace/zephyr/soc/renesas/ra/Kconfig.defconfig"
osource "/media/tecna/disk11/linux/embedded-mcu/BrightC_Workspace/zephyr/soc/realtek/fingerprint/Kconfig.defconfig"
osource "/media/tecna/disk11/linux/embedded-mcu/BrightC_Workspace/zephyr/soc/realtek/ec/Kconfig.defconfig"
osource "/media/tecna/disk11/linux/embedded-mcu/BrightC_Workspace/zephyr/soc/realtek/bee/Kconfig.defconfig"
osource "/media/tecna/disk11/linux/embedded-mcu/BrightC_Workspace/zephyr/soc/realtek/ameba/Kconfig.defconfig"
osource "/media/tecna/disk11/linux/embedded-mcu/BrightC_Workspace/zephyr/soc/raspberrypi/rpi_pico/Kconfig.defconfig"
osource "/media/tecna/disk11/linux/embedded-mcu/BrightC_Workspace/zephyr/soc/quicklogic/eos_s3/Kconfig.defconfig"
osource "/media/tecna/disk11/linux/embedded-mcu/BrightC_Workspace/zephyr/soc/qemu/virt_riscv/Kconfig.defconfig"
osource "/media/tecna/disk11/linux/embedded-mcu/BrightC_Workspace/zephyr/soc/qemu/tricore/Kconfig.defconfig"
osource "/media/tecna/disk11/linux/embedded-mcu/BrightC_Workspace/zephyr/soc/qemu/or1k/Kconfig.defconfig"
osource "/media/tecna/disk11/linux/embedded-mcu/BrightC_Workspace/zephyr/soc/qemu/malta/Kconfig.defconfig"
osource "/media/tecna/disk11/linux/embedded-mcu/BrightC_Workspace/zephyr/soc/qemu/hexagon/Kconfig.defconfig"
osource "/media/tecna/disk11/linux/embedded-mcu/BrightC_Workspace/zephyr/soc/openisa/rv32m1/Kconfig.defconfig"
osource "/media/tecna/disk11/linux/embedded-mcu/BrightC_Workspace/zephyr/soc/openhwgroup/cva6/Kconfig.defconfig"
osource "/media/tecna/disk11/linux/embedded-mcu/BrightC_Workspace/zephyr/soc/oct/osd32mp15x/Kconfig.defconfig"
osource "/media/tecna/disk11/linux/embedded-mcu/BrightC_Workspace/zephyr/soc/nxp/s32/Kconfig.defconfig"
osource "/media/tecna/disk11/linux/embedded-mcu/BrightC_Workspace/zephyr/soc/nxp/rw/Kconfig.defconfig"
osource "/media/tecna/disk11/linux/embedded-mcu/BrightC_Workspace/zephyr/soc/nxp/mcx/Kconfig.defconfig"
osource "/media/tecna/disk11/linux/embedded-mcu/BrightC_Workspace/zephyr/soc/nxp/lpc/Kconfig.defconfig"
osource "/media/tecna/disk11/linux/embedded-mcu/BrightC_Workspace/zephyr/soc/nxp/layerscape/Kconfig.defconfig"
osource "/media/tecna/disk11/linux/embedded-mcu/BrightC_Workspace/zephyr/soc/nxp/kinetis/Kconfig.defconfig"
osource "/media/tecna/disk11/linux/embedded-mcu/BrightC_Workspace/zephyr/soc/nxp/imxrt/Kconfig.defconfig"
osource "/media/tecna/disk11/linux/embedded-mcu/BrightC_Workspace/zephyr/soc/nxp/imx/Kconfig.defconfig"
osource "/media/tecna/disk11/linux/embedded-mcu/BrightC_Workspace/zephyr/soc/nuvoton/numicro/Kconfig.defconfig"
osource "/media/tecna/disk11/linux/embedded-mcu/BrightC_Workspace/zephyr/soc/nuvoton/numaker/Kconfig.defconfig"
osource "/media/tecna/disk11/linux/embedded-mcu/BrightC_Workspace/zephyr/soc/nuvoton/npcx/Kconfig.defconfig"
osource "/media/tecna/disk11/linux/embedded-mcu/BrightC_Workspace/zephyr/soc/nuvoton/npcm/Kconfig.defconfig"
osource "/media/tecna/disk11/linux/embedded-mcu/BrightC_Workspace/zephyr/soc/nordic/Kconfig.defconfig"
osource "/media/tecna/disk11/linux/embedded-mcu/BrightC_Workspace/zephyr/soc/neorv32/Kconfig.defconfig"
osource "/media/tecna/disk11/linux/embedded-mcu/BrightC_Workspace/zephyr/soc/native/inf_clock/Kconfig.defconfig"
osource "/media/tecna/disk11/linux/embedded-mcu/BrightC_Workspace/zephyr/soc/microchip/smartfusion2/Kconfig.defconfig"
osource "/media/tecna/disk11/linux/embedded-mcu/BrightC_Workspace/zephyr/soc/microchip/sam/sama7/Kconfig.defconfig"
osource "/media/tecna/disk11/linux/embedded-mcu/BrightC_Workspace/zephyr/soc/microchip/sam/sama5/Kconfig.defconfig"
osource "/media/tecna/disk11/linux/embedded-mcu/BrightC_Workspace/zephyr/soc/microchip/sam/sam_d5x_e5x/Kconfig.defconfig"
osource "/media/tecna/disk11/linux/embedded-mcu/BrightC_Workspace/zephyr/soc/microchip/pic64/Kconfig.defconfig"
osource "/media/tecna/disk11/linux/embedded-mcu/BrightC_Workspace/zephyr/soc/microchip/pic32c/pic32cz_ca/Kconfig.defconfig"
osource "/media/tecna/disk11/linux/embedded-mcu/BrightC_Workspace/zephyr/soc/microchip/pic32c/pic32cx_sg/Kconfig.defconfig"
osource "/media/tecna/disk11/linux/embedded-mcu/BrightC_Workspace/zephyr/soc/microchip/pic32c/pic32cm_sg_gc/Kconfig.defconfig"
osource "/media/tecna/disk11/linux/embedded-mcu/BrightC_Workspace/zephyr/soc/microchip/pic32c/pic32cm_pl/Kconfig.defconfig"
osource "/media/tecna/disk11/linux/embedded-mcu/BrightC_Workspace/zephyr/soc/microchip/pic32c/pic32cm_jh/Kconfig.defconfig"
osource "/media/tecna/disk11/linux/embedded-mcu/BrightC_Workspace/zephyr/soc/microchip/pic32c/pic32ck_sg_gc/Kconfig.defconfig"
osource "/media/tecna/disk11/linux/embedded-mcu/BrightC_Workspace/zephyr/soc/microchip/miv/Kconfig.defconfig"
osource "/media/tecna/disk11/linux/embedded-mcu/BrightC_Workspace/zephyr/soc/microchip/mec/Kconfig.defconfig"
osource "/media/tecna/disk11/linux/embedded-mcu/BrightC_Workspace/zephyr/soc/mediatek/mt8xxx/Kconfig.defconfig"
osource "/media/tecna/disk11/linux/embedded-mcu/BrightC_Workspace/zephyr/soc/lowrisc/opentitan/Kconfig.defconfig"
osource "/media/tecna/disk11/linux/embedded-mcu/BrightC_Workspace/zephyr/soc/litex/Kconfig.defconfig"
osource "/media/tecna/disk11/linux/embedded-mcu/BrightC_Workspace/zephyr/soc/ite/ec/Kconfig.defconfig"
osource "/media/tecna/disk11/linux/embedded-mcu/BrightC_Workspace/zephyr/soc/intel/wildcat_lake/Kconfig.defconfig"
osource "/media/tecna/disk11/linux/embedded-mcu/BrightC_Workspace/zephyr/soc/intel/raptor_lake/Kconfig.defconfig"
osource "/media/tecna/disk11/linux/embedded-mcu/BrightC_Workspace/zephyr/soc/intel/panther_lake/Kconfig.defconfig"
osource "/media/tecna/disk11/linux/embedded-mcu/BrightC_Workspace/zephyr/soc/intel/nova_lake/Kconfig.defconfig"
osource "/media/tecna/disk11/linux/embedded-mcu/BrightC_Workspace/zephyr/soc/intel/lakemont/Kconfig.defconfig"
osource "/media/tecna/disk11/linux/embedded-mcu/BrightC_Workspace/zephyr/soc/intel/intel_socfpga_std/Kconfig.defconfig"
osource "/media/tecna/disk11/linux/embedded-mcu/BrightC_Workspace/zephyr/soc/intel/intel_socfpga/Kconfig.defconfig"
osource "/media/tecna/disk11/linux/embedded-mcu/BrightC_Workspace/zephyr/soc/intel/intel_niosv/Kconfig.defconfig"
osource "/media/tecna/disk11/linux/embedded-mcu/BrightC_Workspace/zephyr/soc/intel/intel_ish/Kconfig.defconfig"
osource "/media/tecna/disk11/linux/embedded-mcu/BrightC_Workspace/zephyr/soc/intel/intel_adsp/Kconfig.defconfig"
osource "/media/tecna/disk11/linux/embedded-mcu/BrightC_Workspace/zephyr/soc/intel/elkhart_lake/Kconfig.defconfig"
osource "/media/tecna/disk11/linux/embedded-mcu/BrightC_Workspace/zephyr/soc/intel/atom/Kconfig.defconfig"
osource "/media/tecna/disk11/linux/embedded-mcu/BrightC_Workspace/zephyr/soc/intel/apollo_lake/Kconfig.defconfig"
osource "/media/tecna/disk11/linux/embedded-mcu/BrightC_Workspace/zephyr/soc/intel/alder_lake/Kconfig.defconfig"
osource "/media/tecna/disk11/linux/embedded-mcu/BrightC_Workspace/zephyr/soc/infineon/psoc4/Kconfig.defconfig"
osource "/media/tecna/disk11/linux/embedded-mcu/BrightC_Workspace/zephyr/soc/infineon/edge/Kconfig.defconfig"
osource "/media/tecna/disk11/linux/embedded-mcu/BrightC_Workspace/zephyr/soc/infineon/cat3/Kconfig.defconfig"
osource "/media/tecna/disk11/linux/embedded-mcu/BrightC_Workspace/zephyr/soc/infineon/cat1c/Kconfig.defconfig"
osource "/media/tecna/disk11/linux/embedded-mcu/BrightC_Workspace/zephyr/soc/infineon/cat1b/Kconfig.defconfig"
osource "/media/tecna/disk11/linux/embedded-mcu/BrightC_Workspace/zephyr/soc/infineon/cat1a/Kconfig.defconfig"
osource "/media/tecna/disk11/linux/embedded-mcu/BrightC_Workspace/zephyr/soc/gd/gd32/Kconfig.defconfig"
osource "/media/tecna/disk11/linux/embedded-mcu/BrightC_Workspace/zephyr/soc/gaisler/leon3/Kconfig.defconfig"
osource "/media/tecna/disk11/linux/embedded-mcu/BrightC_Workspace/zephyr/soc/gaisler/gr716a/Kconfig.defconfig"
osource "/media/tecna/disk11/linux/embedded-mcu/BrightC_Workspace/zephyr/soc/focaltech/Kconfig.defconfig"
osource "/media/tecna/disk11/linux/embedded-mcu/BrightC_Workspace/zephyr/soc/espressif/Kconfig.defconfig"
osource "/media/tecna/disk11/linux/embedded-mcu/BrightC_Workspace/zephyr/soc/ene/kb1200/Kconfig.defconfig"
osource "/media/tecna/disk11/linux/embedded-mcu/BrightC_Workspace/zephyr/soc/ene/kb106x/Kconfig.defconfig"
osource "/media/tecna/disk11/linux/embedded-mcu/BrightC_Workspace/zephyr/soc/elan/em32f967/Kconfig.defconfig"
osource "/media/tecna/disk11/linux/embedded-mcu/BrightC_Workspace/zephyr/soc/egis/Kconfig.defconfig"
osource "/media/tecna/disk11/linux/embedded-mcu/BrightC_Workspace/zephyr/soc/efinix/sapphire/Kconfig.defconfig"
osource "/media/tecna/disk11/linux/embedded-mcu/BrightC_Workspace/zephyr/soc/cdns/xtensa_sample_controller/Kconfig.defconfig"
osource "/media/tecna/disk11/linux/embedded-mcu/BrightC_Workspace/zephyr/soc/cdns/swerv/Kconfig.defconfig"
osource "/media/tecna/disk11/linux/embedded-mcu/BrightC_Workspace/zephyr/soc/cdns/sample_controller32/Kconfig.defconfig"
osource "/media/tecna/disk11/linux/embedded-mcu/BrightC_Workspace/zephyr/soc/cdns/dc233c/Kconfig.defconfig"
osource "/media/tecna/disk11/linux/embedded-mcu/BrightC_Workspace/zephyr/soc/cdac/Kconfig.defconfig"
osource "/media/tecna/disk11/linux/embedded-mcu/BrightC_Workspace/zephyr/soc/brcm/bcmvk/Kconfig.defconfig"
osource "/media/tecna/disk11/linux/embedded-mcu/BrightC_Workspace/zephyr/soc/brcm/bcm2712/Kconfig.defconfig"
osource "/media/tecna/disk11/linux/embedded-mcu/BrightC_Workspace/zephyr/soc/brcm/bcm2711/Kconfig.defconfig"
osource "/media/tecna/disk11/linux/embedded-mcu/BrightC_Workspace/zephyr/soc/brcm/bcm2710/Kconfig.defconfig"
osource "/media/tecna/disk11/linux/embedded-mcu/BrightC_Workspace/zephyr/soc/blackberry/qnxhv_vm/Kconfig.defconfig"
osource "/media/tecna/disk11/linux/embedded-mcu/BrightC_Workspace/zephyr/soc/bflb/Kconfig.defconfig"
osource "/media/tecna/disk11/linux/embedded-mcu/BrightC_Workspace/zephyr/soc/atmel/sam0/Kconfig.defconfig"
osource "/media/tecna/disk11/linux/embedded-mcu/BrightC_Workspace/zephyr/soc/atmel/sam/Kconfig.defconfig"
osource "/media/tecna/disk11/linux/embedded-mcu/BrightC_Workspace/zephyr/soc/aspeed/Kconfig.defconfig"
osource "/media/tecna/disk11/linux/embedded-mcu/BrightC_Workspace/zephyr/soc/arm/Kconfig.defconfig"
osource "/media/tecna/disk11/linux/embedded-mcu/BrightC_Workspace/zephyr/soc/antmicro/myra/Kconfig.defconfig"
osource "/media/tecna/disk11/linux/embedded-mcu/BrightC_Workspace/zephyr/soc/andestech/Kconfig.defconfig"
osource "/media/tecna/disk11/linux/embedded-mcu/BrightC_Workspace/zephyr/soc/amd/acp_7_x/Kconfig.defconfig"
osource "/media/tecna/disk11/linux/embedded-mcu/BrightC_Workspace/zephyr/soc/amd/acp_7_0/Kconfig.defconfig"
osource "/media/tecna/disk11/linux/embedded-mcu/BrightC_Workspace/zephyr/soc/amd/acp_6_0/Kconfig.defconfig"
osource "/media/tecna/disk11/linux/embedded-mcu/BrightC_Workspace/zephyr/soc/ambiq/Kconfig.defconfig"
osource "/media/tecna/disk11/linux/embedded-mcu/BrightC_Workspace/zephyr/soc/allwinner/sun8i_h3/Kconfig.defconfig"
osource "/media/tecna/disk11/linux/embedded-mcu/BrightC_Workspace/zephyr/soc/allwinner/sun50i_h618/Kconfig.defconfig"
osource "/media/tecna/disk11/linux/embedded-mcu/BrightC_Workspace/zephyr/soc/alif/ensemble/Kconfig.defconfig"
osource "/media/tecna/disk11/linux/embedded-mcu/BrightC_Workspace/zephyr/soc/alif/balletto/Kconfig.defconfig"
osource "/media/tecna/disk11/linux/embedded-mcu/BrightC_Workspace/zephyr/soc/aesc/Kconfig.defconfig"
osource "/media/tecna/disk11/linux/embedded-mcu/BrightC_Workspace/zephyr/soc/adi/max32/Kconfig.defconfig"
```
