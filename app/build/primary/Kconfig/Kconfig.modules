## app/build/primary/Kconfig/soc/Kconfig.sysbuild
```kconfig
# Load Sysbuild SoC Kconfig descriptions.
osource "/media/tecna/disk11/linux/embedded-mcu/BrightC_Workspace/zephyr/soc/xlnx/zynqmp/Kconfig.sysbuild"
osource "/media/tecna/disk11/linux/embedded-mcu/BrightC_Workspace/zephyr/soc/xlnx/zynq7000/Kconfig.sysbuild"
osource "/media/tecna/disk11/linux/embedded-mcu/BrightC_Workspace/zephyr/soc/xlnx/versalnet/Kconfig.sysbuild"
osource "/media/tecna/disk11/linux/embedded-mcu/BrightC_Workspace/zephyr/soc/xlnx/versal2/Kconfig.sysbuild"
osource "/media/tecna/disk11/linux/embedded-mcu/BrightC_Workspace/zephyr/soc/xlnx/versal/Kconfig.sysbuild"
osource "/media/tecna/disk11/linux/embedded-mcu/BrightC_Workspace/zephyr/soc/xen/Kconfig.sysbuild"
osource "/media/tecna/disk11/linux/embedded-mcu/BrightC_Workspace/zephyr/soc/wch/ch32v/Kconfig.sysbuild"
osource "/media/tecna/disk11/linux/embedded-mcu/BrightC_Workspace/zephyr/soc/ti/tiva_c/Kconfig.sysbuild"
osource "/media/tecna/disk11/linux/embedded-mcu/BrightC_Workspace/zephyr/soc/ti/simplelink/Kconfig.sysbuild"
osource "/media/tecna/disk11/linux/embedded-mcu/BrightC_Workspace/zephyr/soc/ti/mspm/Kconfig.sysbuild"
osource "/media/tecna/disk11/linux/embedded-mcu/BrightC_Workspace/zephyr/soc/ti/lm3s6965/Kconfig.sysbuild"
osource "/media/tecna/disk11/linux/embedded-mcu/BrightC_Workspace/zephyr/soc/ti/k3/Kconfig.sysbuild"
osource "/media/tecna/disk11/linux/embedded-mcu/BrightC_Workspace/zephyr/soc/ti/am13/Kconfig.sysbuild"
osource "/media/tecna/disk11/linux/embedded-mcu/BrightC_Workspace/zephyr/soc/telink/tlsr/Kconfig.sysbuild"
osource "/media/tecna/disk11/linux/embedded-mcu/BrightC_Workspace/zephyr/soc/syna/sr100/Kconfig.sysbuild"
osource "/media/tecna/disk11/linux/embedded-mcu/BrightC_Workspace/zephyr/soc/starfive/jh71xx/Kconfig.sysbuild"
osource "/media/tecna/disk11/linux/embedded-mcu/BrightC_Workspace/zephyr/soc/st/stm32/Kconfig.sysbuild"
osource "/media/tecna/disk11/linux/embedded-mcu/BrightC_Workspace/zephyr/soc/snps/qemu_arc/Kconfig.sysbuild"
osource "/media/tecna/disk11/linux/embedded-mcu/BrightC_Workspace/zephyr/soc/snps/nsim/arc_v/Kconfig.sysbuild"
osource "/media/tecna/disk11/linux/embedded-mcu/BrightC_Workspace/zephyr/soc/snps/nsim/arc_classic/Kconfig.sysbuild"
osource "/media/tecna/disk11/linux/embedded-mcu/BrightC_Workspace/zephyr/soc/snps/hsdk4xd/Kconfig.sysbuild"
osource "/media/tecna/disk11/linux/embedded-mcu/BrightC_Workspace/zephyr/soc/snps/hsdk/Kconfig.sysbuild"
osource "/media/tecna/disk11/linux/embedded-mcu/BrightC_Workspace/zephyr/soc/snps/emsk/Kconfig.sysbuild"
osource "/media/tecna/disk11/linux/embedded-mcu/BrightC_Workspace/zephyr/soc/snps/emsdp/Kconfig.sysbuild"
osource "/media/tecna/disk11/linux/embedded-mcu/BrightC_Workspace/zephyr/soc/snps/arc_iot/Kconfig.sysbuild"
osource "/media/tecna/disk11/linux/embedded-mcu/BrightC_Workspace/zephyr/soc/silabs/Kconfig.sysbuild"
osource "/media/tecna/disk11/linux/embedded-mcu/BrightC_Workspace/zephyr/soc/sifli/sf32/Kconfig.sysbuild"
osource "/media/tecna/disk11/linux/embedded-mcu/BrightC_Workspace/zephyr/soc/sifive/sifive_freedom/Kconfig.sysbuild"
osource "/media/tecna/disk11/linux/embedded-mcu/BrightC_Workspace/zephyr/soc/shakti/Kconfig.sysbuild"
osource "/media/tecna/disk11/linux/embedded-mcu/BrightC_Workspace/zephyr/soc/sensry/Kconfig.sysbuild"
osource "/media/tecna/disk11/linux/embedded-mcu/BrightC_Workspace/zephyr/soc/rockchip/Kconfig.sysbuild"
osource "/media/tecna/disk11/linux/embedded-mcu/BrightC_Workspace/zephyr/soc/renode/riscv_virtual/Kconfig.sysbuild"
osource "/media/tecna/disk11/linux/embedded-mcu/BrightC_Workspace/zephyr/soc/renode/cortex_r8_virtual/Kconfig.sysbuild"
osource "/media/tecna/disk11/linux/embedded-mcu/BrightC_Workspace/zephyr/soc/renesas/smartbond/Kconfig.sysbuild"
osource "/media/tecna/disk11/linux/embedded-mcu/BrightC_Workspace/zephyr/soc/renesas/rz/Kconfig.sysbuild"
osource "/media/tecna/disk11/linux/embedded-mcu/BrightC_Workspace/zephyr/soc/renesas/rx/Kconfig.sysbuild"
osource "/media/tecna/disk11/linux/embedded-mcu/BrightC_Workspace/zephyr/soc/renesas/rcar/Kconfig.sysbuild"
osource "/media/tecna/disk11/linux/embedded-mcu/BrightC_Workspace/zephyr/soc/renesas/ra/Kconfig.sysbuild"
osource "/media/tecna/disk11/linux/embedded-mcu/BrightC_Workspace/zephyr/soc/realtek/fingerprint/Kconfig.sysbuild"
osource "/media/tecna/disk11/linux/embedded-mcu/BrightC_Workspace/zephyr/soc/realtek/ec/Kconfig.sysbuild"
osource "/media/tecna/disk11/linux/embedded-mcu/BrightC_Workspace/zephyr/soc/realtek/bee/Kconfig.sysbuild"
osource "/media/tecna/disk11/linux/embedded-mcu/BrightC_Workspace/zephyr/soc/realtek/ameba/Kconfig.sysbuild"
osource "/media/tecna/disk11/linux/embedded-mcu/BrightC_Workspace/zephyr/soc/raspberrypi/rpi_pico/Kconfig.sysbuild"
osource "/media/tecna/disk11/linux/embedded-mcu/BrightC_Workspace/zephyr/soc/quicklogic/eos_s3/Kconfig.sysbuild"
osource "/media/tecna/disk11/linux/embedded-mcu/BrightC_Workspace/zephyr/soc/qemu/virt_riscv/Kconfig.sysbuild"
osource "/media/tecna/disk11/linux/embedded-mcu/BrightC_Workspace/zephyr/soc/qemu/tricore/Kconfig.sysbuild"
osource "/media/tecna/disk11/linux/embedded-mcu/BrightC_Workspace/zephyr/soc/qemu/or1k/Kconfig.sysbuild"
osource "/media/tecna/disk11/linux/embedded-mcu/BrightC_Workspace/zephyr/soc/qemu/malta/Kconfig.sysbuild"
osource "/media/tecna/disk11/linux/embedded-mcu/BrightC_Workspace/zephyr/soc/qemu/hexagon/Kconfig.sysbuild"
osource "/media/tecna/disk11/linux/embedded-mcu/BrightC_Workspace/zephyr/soc/openisa/rv32m1/Kconfig.sysbuild"
osource "/media/tecna/disk11/linux/embedded-mcu/BrightC_Workspace/zephyr/soc/openhwgroup/cva6/Kconfig.sysbuild"
osource "/media/tecna/disk11/linux/embedded-mcu/BrightC_Workspace/zephyr/soc/oct/osd32mp15x/Kconfig.sysbuild"
osource "/media/tecna/disk11/linux/embedded-mcu/BrightC_Workspace/zephyr/soc/nxp/s32/Kconfig.sysbuild"
osource "/media/tecna/disk11/linux/embedded-mcu/BrightC_Workspace/zephyr/soc/nxp/rw/Kconfig.sysbuild"
osource "/media/tecna/disk11/linux/embedded-mcu/BrightC_Workspace/zephyr/soc/nxp/mcx/Kconfig.sysbuild"
osource "/media/tecna/disk11/linux/embedded-mcu/BrightC_Workspace/zephyr/soc/nxp/lpc/Kconfig.sysbuild"
osource "/media/tecna/disk11/linux/embedded-mcu/BrightC_Workspace/zephyr/soc/nxp/layerscape/Kconfig.sysbuild"
osource "/media/tecna/disk11/linux/embedded-mcu/BrightC_Workspace/zephyr/soc/nxp/kinetis/Kconfig.sysbuild"
osource "/media/tecna/disk11/linux/embedded-mcu/BrightC_Workspace/zephyr/soc/nxp/imxrt/Kconfig.sysbuild"
osource "/media/tecna/disk11/linux/embedded-mcu/BrightC_Workspace/zephyr/soc/nxp/imx/Kconfig.sysbuild"
osource "/media/tecna/disk11/linux/embedded-mcu/BrightC_Workspace/zephyr/soc/nuvoton/numicro/Kconfig.sysbuild"
osource "/media/tecna/disk11/linux/embedded-mcu/BrightC_Workspace/zephyr/soc/nuvoton/numaker/Kconfig.sysbuild"
osource "/media/tecna/disk11/linux/embedded-mcu/BrightC_Workspace/zephyr/soc/nuvoton/npcx/Kconfig.sysbuild"
osource "/media/tecna/disk11/linux/embedded-mcu/BrightC_Workspace/zephyr/soc/nuvoton/npcm/Kconfig.sysbuild"
osource "/media/tecna/disk11/linux/embedded-mcu/BrightC_Workspace/zephyr/soc/nordic/Kconfig.sysbuild"
osource "/media/tecna/disk11/linux/embedded-mcu/BrightC_Workspace/zephyr/soc/neorv32/Kconfig.sysbuild"
osource "/media/tecna/disk11/linux/embedded-mcu/BrightC_Workspace/zephyr/soc/native/inf_clock/Kconfig.sysbuild"
osource "/media/tecna/disk11/linux/embedded-mcu/BrightC_Workspace/zephyr/soc/microchip/smartfusion2/Kconfig.sysbuild"
osource "/media/tecna/disk11/linux/embedded-mcu/BrightC_Workspace/zephyr/soc/microchip/sam/sama7/Kconfig.sysbuild"
osource "/media/tecna/disk11/linux/embedded-mcu/BrightC_Workspace/zephyr/soc/microchip/sam/sama5/Kconfig.sysbuild"
osource "/media/tecna/disk11/linux/embedded-mcu/BrightC_Workspace/zephyr/soc/microchip/sam/sam_d5x_e5x/Kconfig.sysbuild"
osource "/media/tecna/disk11/linux/embedded-mcu/BrightC_Workspace/zephyr/soc/microchip/pic64/Kconfig.sysbuild"
osource "/media/tecna/disk11/linux/embedded-mcu/BrightC_Workspace/zephyr/soc/microchip/pic32c/pic32cz_ca/Kconfig.sysbuild"
osource "/media/tecna/disk11/linux/embedded-mcu/BrightC_Workspace/zephyr/soc/microchip/pic32c/pic32cx_sg/Kconfig.sysbuild"
osource "/media/tecna/disk11/linux/embedded-mcu/BrightC_Workspace/zephyr/soc/microchip/pic32c/pic32cm_sg_gc/Kconfig.sysbuild"
osource "/media/tecna/disk11/linux/embedded-mcu/BrightC_Workspace/zephyr/soc/microchip/pic32c/pic32cm_pl/Kconfig.sysbuild"
osource "/media/tecna/disk11/linux/embedded-mcu/BrightC_Workspace/zephyr/soc/microchip/pic32c/pic32cm_jh/Kconfig.sysbuild"
osource "/media/tecna/disk11/linux/embedded-mcu/BrightC_Workspace/zephyr/soc/microchip/pic32c/pic32ck_sg_gc/Kconfig.sysbuild"
osource "/media/tecna/disk11/linux/embedded-mcu/BrightC_Workspace/zephyr/soc/microchip/miv/Kconfig.sysbuild"
osource "/media/tecna/disk11/linux/embedded-mcu/BrightC_Workspace/zephyr/soc/microchip/mec/Kconfig.sysbuild"
osource "/media/tecna/disk11/linux/embedded-mcu/BrightC_Workspace/zephyr/soc/mediatek/mt8xxx/Kconfig.sysbuild"
osource "/media/tecna/disk11/linux/embedded-mcu/BrightC_Workspace/zephyr/soc/lowrisc/opentitan/Kconfig.sysbuild"
osource "/media/tecna/disk11/linux/embedded-mcu/BrightC_Workspace/zephyr/soc/litex/Kconfig.sysbuild"
osource "/media/tecna/disk11/linux/embedded-mcu/BrightC_Workspace/zephyr/soc/ite/ec/Kconfig.sysbuild"
osource "/media/tecna/disk11/linux/embedded-mcu/BrightC_Workspace/zephyr/soc/intel/wildcat_lake/Kconfig.sysbuild"
osource "/media/tecna/disk11/linux/embedded-mcu/BrightC_Workspace/zephyr/soc/intel/raptor_lake/Kconfig.sysbuild"
osource "/media/tecna/disk11/linux/embedded-mcu/BrightC_Workspace/zephyr/soc/intel/panther_lake/Kconfig.sysbuild"
osource "/media/tecna/disk11/linux/embedded-mcu/BrightC_Workspace/zephyr/soc/intel/nova_lake/Kconfig.sysbuild"
osource "/media/tecna/disk11/linux/embedded-mcu/BrightC_Workspace/zephyr/soc/intel/lakemont/Kconfig.sysbuild"
osource "/media/tecna/disk11/linux/embedded-mcu/BrightC_Workspace/zephyr/soc/intel/intel_socfpga_std/Kconfig.sysbuild"
osource "/media/tecna/disk11/linux/embedded-mcu/BrightC_Workspace/zephyr/soc/intel/intel_socfpga/Kconfig.sysbuild"
osource "/media/tecna/disk11/linux/embedded-mcu/BrightC_Workspace/zephyr/soc/intel/intel_niosv/Kconfig.sysbuild"
osource "/media/tecna/disk11/linux/embedded-mcu/BrightC_Workspace/zephyr/soc/intel/intel_ish/Kconfig.sysbuild"
osource "/media/tecna/disk11/linux/embedded-mcu/BrightC_Workspace/zephyr/soc/intel/intel_adsp/Kconfig.sysbuild"
osource "/media/tecna/disk11/linux/embedded-mcu/BrightC_Workspace/zephyr/soc/intel/elkhart_lake/Kconfig.sysbuild"
osource "/media/tecna/disk11/linux/embedded-mcu/BrightC_Workspace/zephyr/soc/intel/atom/Kconfig.sysbuild"
osource "/media/tecna/disk11/linux/embedded-mcu/BrightC_Workspace/zephyr/soc/intel/apollo_lake/Kconfig.sysbuild"
osource "/media/tecna/disk11/linux/embedded-mcu/BrightC_Workspace/zephyr/soc/intel/alder_lake/Kconfig.sysbuild"
osource "/media/tecna/disk11/linux/embedded-mcu/BrightC_Workspace/zephyr/soc/infineon/psoc4/Kconfig.sysbuild"
osource "/media/tecna/disk11/linux/embedded-mcu/BrightC_Workspace/zephyr/soc/infineon/edge/Kconfig.sysbuild"
osource "/media/tecna/disk11/linux/embedded-mcu/BrightC_Workspace/zephyr/soc/infineon/cat3/Kconfig.sysbuild"
osource "/media/tecna/disk11/linux/embedded-mcu/BrightC_Workspace/zephyr/soc/infineon/cat1c/Kconfig.sysbuild"
osource "/media/tecna/disk11/linux/embedded-mcu/BrightC_Workspace/zephyr/soc/infineon/cat1b/Kconfig.sysbuild"
osource "/media/tecna/disk11/linux/embedded-mcu/BrightC_Workspace/zephyr/soc/infineon/cat1a/Kconfig.sysbuild"
osource "/media/tecna/disk11/linux/embedded-mcu/BrightC_Workspace/zephyr/soc/gd/gd32/Kconfig.sysbuild"
osource "/media/tecna/disk11/linux/embedded-mcu/BrightC_Workspace/zephyr/soc/gaisler/leon3/Kconfig.sysbuild"
osource "/media/tecna/disk11/linux/embedded-mcu/BrightC_Workspace/zephyr/soc/gaisler/gr716a/Kconfig.sysbuild"
osource "/media/tecna/disk11/linux/embedded-mcu/BrightC_Workspace/zephyr/soc/focaltech/Kconfig.sysbuild"
osource "/media/tecna/disk11/linux/embedded-mcu/BrightC_Workspace/zephyr/soc/espressif/Kconfig.sysbuild"
osource "/media/tecna/disk11/linux/embedded-mcu/BrightC_Workspace/zephyr/soc/ene/kb1200/Kconfig.sysbuild"
osource "/media/tecna/disk11/linux/embedded-mcu/BrightC_Workspace/zephyr/soc/ene/kb106x/Kconfig.sysbuild"
osource "/media/tecna/disk11/linux/embedded-mcu/BrightC_Workspace/zephyr/soc/elan/em32f967/Kconfig.sysbuild"
osource "/media/tecna/disk11/linux/embedded-mcu/BrightC_Workspace/zephyr/soc/egis/Kconfig.sysbuild"
osource "/media/tecna/disk11/linux/embedded-mcu/BrightC_Workspace/zephyr/soc/efinix/sapphire/Kconfig.sysbuild"
osource "/media/tecna/disk11/linux/embedded-mcu/BrightC_Workspace/zephyr/soc/cdns/xtensa_sample_controller/Kconfig.sysbuild"
osource "/media/tecna/disk11/linux/embedded-mcu/BrightC_Workspace/zephyr/soc/cdns/swerv/Kconfig.sysbuild"
osource "/media/tecna/disk11/linux/embedded-mcu/BrightC_Workspace/zephyr/soc/cdns/sample_controller32/Kconfig.sysbuild"
osource "/media/tecna/disk11/linux/embedded-mcu/BrightC_Workspace/zephyr/soc/cdns/dc233c/Kconfig.sysbuild"
osource "/media/tecna/disk11/linux/embedded-mcu/BrightC_Workspace/zephyr/soc/cdac/Kconfig.sysbuild"
osource "/media/tecna/disk11/linux/embedded-mcu/BrightC_Workspace/zephyr/soc/brcm/bcmvk/Kconfig.sysbuild"
osource "/media/tecna/disk11/linux/embedded-mcu/BrightC_Workspace/zephyr/soc/brcm/bcm2712/Kconfig.sysbuild"
osource "/media/tecna/disk11/linux/embedded-mcu/BrightC_Workspace/zephyr/soc/brcm/bcm2711/Kconfig.sysbuild"
osource "/media/tecna/disk11/linux/embedded-mcu/BrightC_Workspace/zephyr/soc/brcm/bcm2710/Kconfig.sysbuild"
osource "/media/tecna/disk11/linux/embedded-mcu/BrightC_Workspace/zephyr/soc/blackberry/qnxhv_vm/Kconfig.sysbuild"
osource "/media/tecna/disk11/linux/embedded-mcu/BrightC_Workspace/zephyr/soc/bflb/Kconfig.sysbuild"
osource "/media/tecna/disk11/linux/embedded-mcu/BrightC_Workspace/zephyr/soc/atmel/sam0/Kconfig.sysbuild"
osource "/media/tecna/disk11/linux/embedded-mcu/BrightC_Workspace/zephyr/soc/atmel/sam/Kconfig.sysbuild"
osource "/media/tecna/disk11/linux/embedded-mcu/BrightC_Workspace/zephyr/soc/aspeed/Kconfig.sysbuild"
osource "/media/tecna/disk11/linux/embedded-mcu/BrightC_Workspace/zephyr/soc/arm/Kconfig.sysbuild"
osource "/media/tecna/disk11/linux/embedded-mcu/BrightC_Workspace/zephyr/soc/antmicro/myra/Kconfig.sysbuild"
osource "/media/tecna/disk11/linux/embedded-mcu/BrightC_Workspace/zephyr/soc/andestech/Kconfig.sysbuild"
osource "/media/tecna/disk11/linux/embedded-mcu/BrightC_Workspace/zephyr/soc/amd/acp_7_x/Kconfig.sysbuild"
osource "/media/tecna/disk11/linux/embedded-mcu/BrightC_Workspace/zephyr/soc/amd/acp_7_0/Kconfig.sysbuild"
osource "/media/tecna/disk11/linux/embedded-mcu/BrightC_Workspace/zephyr/soc/amd/acp_6_0/Kconfig.sysbuild"
osource "/media/tecna/disk11/linux/embedded-mcu/BrightC_Workspace/zephyr/soc/ambiq/Kconfig.sysbuild"
osource "/media/tecna/disk11/linux/embedded-mcu/BrightC_Workspace/zephyr/soc/allwinner/sun8i_h3/Kconfig.sysbuild"
osource "/media/tecna/disk11/linux/embedded-mcu/BrightC_Workspace/zephyr/soc/allwinner/sun50i_h618/Kconfig.sysbuild"
osource "/media/tecna/disk11/linux/embedded-mcu/BrightC_Workspace/zephyr/soc/alif/ensemble/Kconfig.sysbuild"
osource "/media/tecna/disk11/linux/embedded-mcu/BrightC_Workspace/zephyr/soc/alif/balletto/Kconfig.sysbuild"
osource "/media/tecna/disk11/linux/embedded-mcu/BrightC_Workspace/zephyr/soc/aesc/Kconfig.sysbuild"
osource "/media/tecna/disk11/linux/embedded-mcu/BrightC_Workspace/zephyr/soc/adi/max32/Kconfig.sysbuild"
```

## temp/brightc_h743zi/Kconfig.brightc_h743zi
```kconfig
# Copyright (c) 2020 Teslabs Engineering S.L.
# SPDX-License-Identifier: Apache-2.0

config BOARD_BRIGHTC_H743ZI
	select SOC_STM32H743XX
```

## temp/brightc_h743zi/Kconfig.defconfig
```kconfig
# BrightC-B1 H743ZI BaseBoard V3 configuration

# SPDX-License-Identifier: Apache-2.0

if BOARD_BRIGHTC_H743ZI

configdefault NET_L2_ETHERNET
	default y

endif # BOARD_BRIGHTC_H743ZI
```
