## app/build/primary/Kconfig/Kconfig.modules
```kconfig
menu "BrightC_NewFirmware (/media/tecna/disk11/linux/embedded-mcu/BrightC_Workspace/BrightC_NewFirmware)"
osource "/media/tecna/disk11/linux/embedded-mcu/BrightC_Workspace/BrightC_NewFirmware/Kconfig"
config ZEPHYR_BRIGHTC_NEWFIRMWARE_MODULE
	bool
	default y
endmenu
menu "microconf (/media/tecna/disk11/linux/embedded-mcu/BrightC_Workspace/modules/lib/microconf)"
osource "/media/tecna/disk11/linux/embedded-mcu/BrightC_Workspace/modules/lib/microconf/zephyr/Kconfig"
config ZEPHYR_MICROCONF_MODULE
	bool
	default y
endmenu
menu "cmsis-dsp (/media/tecna/disk11/linux/embedded-mcu/BrightC_Workspace/modules/lib/cmsis-dsp)"
osource "/media/tecna/disk11/linux/embedded-mcu/BrightC_Workspace/modules/lib/cmsis-dsp/zephyr/Kconfig"
config ZEPHYR_CMSIS_DSP_MODULE
	bool
	default y
endmenu
menu "cmsis-nn (/media/tecna/disk11/linux/embedded-mcu/BrightC_Workspace/modules/lib/cmsis-nn)"
osource "$(ZEPHYR_CMSIS_NN_KCONFIG)"
config ZEPHYR_CMSIS_NN_MODULE
	bool
	default y
endmenu
menu "cmsis_6 (/media/tecna/disk11/linux/embedded-mcu/BrightC_Workspace/modules/hal/cmsis_6)"
osource "$(ZEPHYR_CMSIS_6_KCONFIG)"
config ZEPHYR_CMSIS_6_MODULE
	bool
	default y
endmenu
menu "fatfs (/media/tecna/disk11/linux/embedded-mcu/BrightC_Workspace/modules/fs/fatfs)"
osource "$(ZEPHYR_FATFS_KCONFIG)"
config ZEPHYR_FATFS_MODULE
	bool
	default y
endmenu
menu "hal_nordic (/media/tecna/disk11/linux/embedded-mcu/BrightC_Workspace/modules/hal/nordic)"
osource "$(ZEPHYR_HAL_NORDIC_KCONFIG)"
config ZEPHYR_HAL_NORDIC_MODULE
	bool
	default y

config ZEPHYR_HAL_NORDIC_MODULE_BLOBS
	bool
endmenu
config ZEPHYR_HAL_STM32_MODULE
	bool
	default y

config ZEPHYR_HAL_STM32_MODULE_BLOBS
	bool
menu "lvgl (/media/tecna/disk11/linux/embedded-mcu/BrightC_Workspace/modules/lib/gui/lvgl)"
osource "/media/tecna/disk11/linux/embedded-mcu/BrightC_Workspace/modules/lib/gui/lvgl/zephyr/Kconfig"
config ZEPHYR_LVGL_MODULE
	bool
	default y
endmenu
menu "mbedtls (/media/tecna/disk11/linux/embedded-mcu/BrightC_Workspace/modules/crypto/mbedtls)"
osource "$(ZEPHYR_MBEDTLS_KCONFIG)"
config ZEPHYR_MBEDTLS_MODULE
	bool
	default y
endmenu
config ZEPHYR_MIPI_SYS_T_MODULE
	bool
	default y
config ZEPHYR_MLDSA_NATIVE_MODULE
	bool
	default y
menu "percepio (/media/tecna/disk11/linux/embedded-mcu/BrightC_Workspace/modules/debug/percepio)"
osource "/media/tecna/disk11/linux/embedded-mcu/BrightC_Workspace/modules/debug/percepio/zephyr/Kconfig"
config ZEPHYR_PERCEPIO_MODULE
	bool
	default y
endmenu
menu "segger (/media/tecna/disk11/linux/embedded-mcu/BrightC_Workspace/modules/debug/segger)"
osource "$(ZEPHYR_SEGGER_KCONFIG)"
config ZEPHYR_SEGGER_MODULE
	bool
	default y
endmenu
config ZEPHYR_TF_PSA_CRYPTO_MODULE
	bool
	default y
menu "zcbor (/media/tecna/disk11/linux/embedded-mcu/BrightC_Workspace/modules/lib/zcbor)"
osource "$(ZEPHYR_ZCBOR_KCONFIG)"
config ZEPHYR_ZCBOR_MODULE
	bool
	default y
endmenu
```

## app/build/primary/Kconfig/Kconfig.shield
```kconfig
osource "/media/tecna/disk11/linux/embedded-mcu/BrightC_Workspace/BrightC_NewFirmware/boards/shields/*/Kconfig.shield"
```

## app/build/primary/Kconfig/Kconfig.sysbuild.modules
```kconfig
config ZEPHYR_BRIGHTC_NEWFIRMWARE_MODULE
   bool
   default y
config ZEPHYR_MICROCONF_MODULE
   bool
   default y
config ZEPHYR_CMSIS_DSP_MODULE
   bool
   default y
config ZEPHYR_CMSIS_NN_MODULE
   bool
   default y
config ZEPHYR_CMSIS_6_MODULE
   bool
   default y
config ZEPHYR_FATFS_MODULE
   bool
   default y
config ZEPHYR_HAL_NORDIC_MODULE
   bool
   default y
config ZEPHYR_HAL_STM32_MODULE
   bool
   default y
config ZEPHYR_LVGL_MODULE
   bool
   default y
config ZEPHYR_MBEDTLS_MODULE
   bool
   default y
config ZEPHYR_MIPI_SYS_T_MODULE
   bool
   default y
config ZEPHYR_MLDSA_NATIVE_MODULE
   bool
   default y
config ZEPHYR_PERCEPIO_MODULE
   bool
   default y
config ZEPHYR_SEGGER_MODULE
   bool
   default y
config ZEPHYR_TF_PSA_CRYPTO_MODULE
   bool
   default y
config ZEPHYR_ZCBOR_MODULE
   bool
   default y
```

## app/build/primary/Kconfig/arch/Kconfig
```kconfig
# Load Zephyr Arch Kconfig descriptions.
osource "/media/tecna/disk11/linux/embedded-mcu/BrightC_Workspace/zephyr/arch/tricore/Kconfig"
osource "/media/tecna/disk11/linux/embedded-mcu/BrightC_Workspace/zephyr/arch/hexagon/Kconfig"
osource "/media/tecna/disk11/linux/embedded-mcu/BrightC_Workspace/zephyr/arch/rx/Kconfig"
osource "/media/tecna/disk11/linux/embedded-mcu/BrightC_Workspace/zephyr/arch/x86/Kconfig"
osource "/media/tecna/disk11/linux/embedded-mcu/BrightC_Workspace/zephyr/arch/xtensa/Kconfig"
osource "/media/tecna/disk11/linux/embedded-mcu/BrightC_Workspace/zephyr/arch/sparc/Kconfig"
osource "/media/tecna/disk11/linux/embedded-mcu/BrightC_Workspace/zephyr/arch/riscv/Kconfig"
osource "/media/tecna/disk11/linux/embedded-mcu/BrightC_Workspace/zephyr/arch/posix/Kconfig"
osource "/media/tecna/disk11/linux/embedded-mcu/BrightC_Workspace/zephyr/arch/openrisc/Kconfig"
osource "/media/tecna/disk11/linux/embedded-mcu/BrightC_Workspace/zephyr/arch/mips/Kconfig"
osource "/media/tecna/disk11/linux/embedded-mcu/BrightC_Workspace/zephyr/arch/arm64/Kconfig"
osource "/media/tecna/disk11/linux/embedded-mcu/BrightC_Workspace/zephyr/arch/arm/Kconfig"
osource "/media/tecna/disk11/linux/embedded-mcu/BrightC_Workspace/zephyr/arch/arc/Kconfig"
```

## app/build/primary/Kconfig/boards/Kconfig.sysbuild
```kconfig
# Load Sysbuild board Kconfig descriptions.
osource "/media/tecna/disk11/linux/embedded-mcu/BrightC_Workspace/BrightC_NewFirmware/boards/daecge/brightc-controllerv3/Kconfig.sysbuild"
```
