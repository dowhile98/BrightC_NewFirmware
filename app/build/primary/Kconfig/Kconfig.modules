## app/build/primary/Kconfig/soc/Kconfig.soc
```kconfig
# Load SoC Kconfig descriptions.
osource "/media/tecna/disk11/linux/embedded-mcu/BrightC_Workspace/zephyr/soc/xlnx/zynqmp/Kconfig.soc"
osource "/media/tecna/disk11/linux/embedded-mcu/BrightC_Workspace/zephyr/soc/xlnx/zynq7000/Kconfig.soc"
osource "/media/tecna/disk11/linux/embedded-mcu/BrightC_Workspace/zephyr/soc/xlnx/versalnet/Kconfig.soc"
osource "/media/tecna/disk11/linux/embedded-mcu/BrightC_Workspace/zephyr/soc/xlnx/versal2/Kconfig.soc"
osource "/media/tecna/disk11/linux/embedded-mcu/BrightC_Workspace/zephyr/soc/xlnx/versal/Kconfig.soc"
osource "/media/tecna/disk11/linux/embedded-mcu/BrightC_Workspace/zephyr/soc/xen/Kconfig.soc"
osource "/media/tecna/disk11/linux/embedded-mcu/BrightC_Workspace/zephyr/soc/wch/ch32v/Kconfig.soc"
osource "/media/tecna/disk11/linux/embedded-mcu/BrightC_Workspace/zephyr/soc/ti/tiva_c/Kconfig.soc"
osource "/media/tecna/disk11/linux/embedded-mcu/BrightC_Workspace/zephyr/soc/ti/simplelink/Kconfig.soc"
osource "/media/tecna/disk11/linux/embedded-mcu/BrightC_Workspace/zephyr/soc/ti/mspm/Kconfig.soc"
osource "/media/tecna/disk11/linux/embedded-mcu/BrightC_Workspace/zephyr/soc/ti/lm3s6965/Kconfig.soc"
osource "/media/tecna/disk11/linux/embedded-mcu/BrightC_Workspace/zephyr/soc/ti/k3/Kconfig.soc"
osource "/media/tecna/disk11/linux/embedded-mcu/BrightC_Workspace/zephyr/soc/ti/am13/Kconfig.soc"
osource "/media/tecna/disk11/linux/embedded-mcu/BrightC_Workspace/zephyr/soc/telink/tlsr/Kconfig.soc"
osource "/media/tecna/disk11/linux/embedded-mcu/BrightC_Workspace/zephyr/soc/syna/sr100/Kconfig.soc"
osource "/media/tecna/disk11/linux/embedded-mcu/BrightC_Workspace/zephyr/soc/starfive/jh71xx/Kconfig.soc"
osource "/media/tecna/disk11/linux/embedded-mcu/BrightC_Workspace/zephyr/soc/st/stm32/Kconfig.soc"
osource "/media/tecna/disk11/linux/embedded-mcu/BrightC_Workspace/zephyr/soc/snps/qemu_arc/Kconfig.soc"
osource "/media/tecna/disk11/linux/embedded-mcu/BrightC_Workspace/zephyr/soc/snps/nsim/arc_v/Kconfig.soc"
osource "/media/tecna/disk11/linux/embedded-mcu/BrightC_Workspace/zephyr/soc/snps/nsim/arc_classic/Kconfig.soc"
osource "/media/tecna/disk11/linux/embedded-mcu/BrightC_Workspace/zephyr/soc/snps/hsdk4xd/Kconfig.soc"
osource "/media/tecna/disk11/linux/embedded-mcu/BrightC_Workspace/zephyr/soc/snps/hsdk/Kconfig.soc"
osource "/media/tecna/disk11/linux/embedded-mcu/BrightC_Workspace/zephyr/soc/snps/emsk/Kconfig.soc"
osource "/media/tecna/disk11/linux/embedded-mcu/BrightC_Workspace/zephyr/soc/snps/emsdp/Kconfig.soc"
osource "/media/tecna/disk11/linux/embedded-mcu/BrightC_Workspace/zephyr/soc/snps/arc_iot/Kconfig.soc"
osource "/media/tecna/disk11/linux/embedded-mcu/BrightC_Workspace/zephyr/soc/silabs/Kconfig.soc"
osource "/media/tecna/disk11/linux/embedded-mcu/BrightC_Workspace/zephyr/soc/sifli/sf32/Kconfig.soc"
osource "/media/tecna/disk11/linux/embedded-mcu/BrightC_Workspace/zephyr/soc/sifive/sifive_freedom/Kconfig.soc"
osource "/media/tecna/disk11/linux/embedded-mcu/BrightC_Workspace/zephyr/soc/shakti/Kconfig.soc"
osource "/media/tecna/disk11/linux/embedded-mcu/BrightC_Workspace/zephyr/soc/sensry/Kconfig.soc"
osource "/media/tecna/disk11/linux/embedded-mcu/BrightC_Workspace/zephyr/soc/rockchip/Kconfig.soc"
osource "/media/tecna/disk11/linux/embedded-mcu/BrightC_Workspace/zephyr/soc/renode/riscv_virtual/Kconfig.soc"
osource "/media/tecna/disk11/linux/embedded-mcu/BrightC_Workspace/zephyr/soc/renode/cortex_r8_virtual/Kconfig.soc"
osource "/media/tecna/disk11/linux/embedded-mcu/BrightC_Workspace/zephyr/soc/renesas/smartbond/Kconfig.soc"
osource "/media/tecna/disk11/linux/embedded-mcu/BrightC_Workspace/zephyr/soc/renesas/rz/Kconfig.soc"
osource "/media/tecna/disk11/linux/embedded-mcu/BrightC_Workspace/zephyr/soc/renesas/rx/Kconfig.soc"
osource "/media/tecna/disk11/linux/embedded-mcu/BrightC_Workspace/zephyr/soc/renesas/rcar/Kconfig.soc"
osource "/media/tecna/disk11/linux/embedded-mcu/BrightC_Workspace/zephyr/soc/renesas/ra/Kconfig.soc"
osource "/media/tecna/disk11/linux/embedded-mcu/BrightC_Workspace/zephyr/soc/realtek/fingerprint/Kconfig.soc"
osource "/media/tecna/disk11/linux/embedded-mcu/BrightC_Workspace/zephyr/soc/realtek/ec/Kconfig.soc"
osource "/media/tecna/disk11/linux/embedded-mcu/BrightC_Workspace/zephyr/soc/realtek/bee/Kconfig.soc"
osource "/media/tecna/disk11/linux/embedded-mcu/BrightC_Workspace/zephyr/soc/realtek/ameba/Kconfig.soc"
osource "/media/tecna/disk11/linux/embedded-mcu/BrightC_Workspace/zephyr/soc/raspberrypi/rpi_pico/Kconfig.soc"
osource "/media/tecna/disk11/linux/embedded-mcu/BrightC_Workspace/zephyr/soc/quicklogic/eos_s3/Kconfig.soc"
osource "/media/tecna/disk11/linux/embedded-mcu/BrightC_Workspace/zephyr/soc/qemu/virt_riscv/Kconfig.soc"
osource "/media/tecna/disk11/linux/embedded-mcu/BrightC_Workspace/zephyr/soc/qemu/tricore/Kconfig.soc"
osource "/media/tecna/disk11/linux/embedded-mcu/BrightC_Workspace/zephyr/soc/qemu/or1k/Kconfig.soc"
osource "/media/tecna/disk11/linux/embedded-mcu/BrightC_Workspace/zephyr/soc/qemu/malta/Kconfig.soc"
osource "/media/tecna/disk11/linux/embedded-mcu/BrightC_Workspace/zephyr/soc/qemu/hexagon/Kconfig.soc"
osource "/media/tecna/disk11/linux/embedded-mcu/BrightC_Workspace/zephyr/soc/openisa/rv32m1/Kconfig.soc"
osource "/media/tecna/disk11/linux/embedded-mcu/BrightC_Workspace/zephyr/soc/openhwgroup/cva6/Kconfig.soc"
osource "/media/tecna/disk11/linux/embedded-mcu/BrightC_Workspace/zephyr/soc/oct/osd32mp15x/Kconfig.soc"
osource "/media/tecna/disk11/linux/embedded-mcu/BrightC_Workspace/zephyr/soc/nxp/s32/Kconfig.soc"
osource "/media/tecna/disk11/linux/embedded-mcu/BrightC_Workspace/zephyr/soc/nxp/rw/Kconfig.soc"
osource "/media/tecna/disk11/linux/embedded-mcu/BrightC_Workspace/zephyr/soc/nxp/mcx/Kconfig.soc"
osource "/media/tecna/disk11/linux/embedded-mcu/BrightC_Workspace/zephyr/soc/nxp/lpc/Kconfig.soc"
osource "/media/tecna/disk11/linux/embedded-mcu/BrightC_Workspace/zephyr/soc/nxp/layerscape/Kconfig.soc"
osource "/media/tecna/disk11/linux/embedded-mcu/BrightC_Workspace/zephyr/soc/nxp/kinetis/Kconfig.soc"
osource "/media/tecna/disk11/linux/embedded-mcu/BrightC_Workspace/zephyr/soc/nxp/imxrt/Kconfig.soc"
osource "/media/tecna/disk11/linux/embedded-mcu/BrightC_Workspace/zephyr/soc/nxp/imx/Kconfig.soc"
osource "/media/tecna/disk11/linux/embedded-mcu/BrightC_Workspace/zephyr/soc/nuvoton/numicro/Kconfig.soc"
osource "/media/tecna/disk11/linux/embedded-mcu/BrightC_Workspace/zephyr/soc/nuvoton/numaker/Kconfig.soc"
osource "/media/tecna/disk11/linux/embedded-mcu/BrightC_Workspace/zephyr/soc/nuvoton/npcx/Kconfig.soc"
osource "/media/tecna/disk11/linux/embedded-mcu/BrightC_Workspace/zephyr/soc/nuvoton/npcm/Kconfig.soc"
osource "/media/tecna/disk11/linux/embedded-mcu/BrightC_Workspace/zephyr/soc/nordic/Kconfig.soc"
osource "/media/tecna/disk11/linux/embedded-mcu/BrightC_Workspace/zephyr/soc/neorv32/Kconfig.soc"
osource "/media/tecna/disk11/linux/embedded-mcu/BrightC_Workspace/zephyr/soc/native/inf_clock/Kconfig.soc"
osource "/media/tecna/disk11/linux/embedded-mcu/BrightC_Workspace/zephyr/soc/microchip/smartfusion2/Kconfig.soc"
osource "/media/tecna/disk11/linux/embedded-mcu/BrightC_Workspace/zephyr/soc/microchip/sam/sama7/Kconfig.soc"
osource "/media/tecna/disk11/linux/embedded-mcu/BrightC_Workspace/zephyr/soc/microchip/sam/sama5/Kconfig.soc"
osource "/media/tecna/disk11/linux/embedded-mcu/BrightC_Workspace/zephyr/soc/microchip/sam/sam_d5x_e5x/Kconfig.soc"
osource "/media/tecna/disk11/linux/embedded-mcu/BrightC_Workspace/zephyr/soc/microchip/pic64/Kconfig.soc"
osource "/media/tecna/disk11/linux/embedded-mcu/BrightC_Workspace/zephyr/soc/microchip/pic32c/pic32cz_ca/Kconfig.soc"
osource "/media/tecna/disk11/linux/embedded-mcu/BrightC_Workspace/zephyr/soc/microchip/pic32c/pic32cx_sg/Kconfig.soc"
osource "/media/tecna/disk11/linux/embedded-mcu/BrightC_Workspace/zephyr/soc/microchip/pic32c/pic32cm_sg_gc/Kconfig.soc"
osource "/media/tecna/disk11/linux/embedded-mcu/BrightC_Workspace/zephyr/soc/microchip/pic32c/pic32cm_pl/Kconfig.soc"
osource "/media/tecna/disk11/linux/embedded-mcu/BrightC_Workspace/zephyr/soc/microchip/pic32c/pic32cm_jh/Kconfig.soc"
osource "/media/tecna/disk11/linux/embedded-mcu/BrightC_Workspace/zephyr/soc/microchip/pic32c/pic32ck_sg_gc/Kconfig.soc"
osource "/media/tecna/disk11/linux/embedded-mcu/BrightC_Workspace/zephyr/soc/microchip/miv/Kconfig.soc"
osource "/media/tecna/disk11/linux/embedded-mcu/BrightC_Workspace/zephyr/soc/microchip/mec/Kconfig.soc"
osource "/media/tecna/disk11/linux/embedded-mcu/BrightC_Workspace/zephyr/soc/mediatek/mt8xxx/Kconfig.soc"
osource "/media/tecna/disk11/linux/embedded-mcu/BrightC_Workspace/zephyr/soc/lowrisc/opentitan/Kconfig.soc"
osource "/media/tecna/disk11/linux/embedded-mcu/BrightC_Workspace/zephyr/soc/litex/Kconfig.soc"
osource "/media/tecna/disk11/linux/embedded-mcu/BrightC_Workspace/zephyr/soc/ite/ec/Kconfig.soc"
osource "/media/tecna/disk11/linux/embedded-mcu/BrightC_Workspace/zephyr/soc/intel/wildcat_lake/Kconfig.soc"
osource "/media/tecna/disk11/linux/embedded-mcu/BrightC_Workspace/zephyr/soc/intel/raptor_lake/Kconfig.soc"
osource "/media/tecna/disk11/linux/embedded-mcu/BrightC_Workspace/zephyr/soc/intel/panther_lake/Kconfig.soc"
osource "/media/tecna/disk11/linux/embedded-mcu/BrightC_Workspace/zephyr/soc/intel/nova_lake/Kconfig.soc"
osource "/media/tecna/disk11/linux/embedded-mcu/BrightC_Workspace/zephyr/soc/intel/lakemont/Kconfig.soc"
osource "/media/tecna/disk11/linux/embedded-mcu/BrightC_Workspace/zephyr/soc/intel/intel_socfpga_std/Kconfig.soc"
osource "/media/tecna/disk11/linux/embedded-mcu/BrightC_Workspace/zephyr/soc/intel/intel_socfpga/Kconfig.soc"
osource "/media/tecna/disk11/linux/embedded-mcu/BrightC_Workspace/zephyr/soc/intel/intel_niosv/Kconfig.soc"
osource "/media/tecna/disk11/linux/embedded-mcu/BrightC_Workspace/zephyr/soc/intel/intel_ish/Kconfig.soc"
osource "/media/tecna/disk11/linux/embedded-mcu/BrightC_Workspace/zephyr/soc/intel/intel_adsp/Kconfig.soc"
osource "/media/tecna/disk11/linux/embedded-mcu/BrightC_Workspace/zephyr/soc/intel/elkhart_lake/Kconfig.soc"
osource "/media/tecna/disk11/linux/embedded-mcu/BrightC_Workspace/zephyr/soc/intel/atom/Kconfig.soc"
osource "/media/tecna/disk11/linux/embedded-mcu/BrightC_Workspace/zephyr/soc/intel/apollo_lake/Kconfig.soc"
osource "/media/tecna/disk11/linux/embedded-mcu/BrightC_Workspace/zephyr/soc/intel/alder_lake/Kconfig.soc"
osource "/media/tecna/disk11/linux/embedded-mcu/BrightC_Workspace/zephyr/soc/infineon/psoc4/Kconfig.soc"
osource "/media/tecna/disk11/linux/embedded-mcu/BrightC_Workspace/zephyr/soc/infineon/edge/Kconfig.soc"
osource "/media/tecna/disk11/linux/embedded-mcu/BrightC_Workspace/zephyr/soc/infineon/cat3/Kconfig.soc"
osource "/media/tecna/disk11/linux/embedded-mcu/BrightC_Workspace/zephyr/soc/infineon/cat1c/Kconfig.soc"
osource "/media/tecna/disk11/linux/embedded-mcu/BrightC_Workspace/zephyr/soc/infineon/cat1b/Kconfig.soc"
osource "/media/tecna/disk11/linux/embedded-mcu/BrightC_Workspace/zephyr/soc/infineon/cat1a/Kconfig.soc"
osource "/media/tecna/disk11/linux/embedded-mcu/BrightC_Workspace/zephyr/soc/gd/gd32/Kconfig.soc"
osource "/media/tecna/disk11/linux/embedded-mcu/BrightC_Workspace/zephyr/soc/gaisler/leon3/Kconfig.soc"
osource "/media/tecna/disk11/linux/embedded-mcu/BrightC_Workspace/zephyr/soc/gaisler/gr716a/Kconfig.soc"
osource "/media/tecna/disk11/linux/embedded-mcu/BrightC_Workspace/zephyr/soc/focaltech/Kconfig.soc"
osource "/media/tecna/disk11/linux/embedded-mcu/BrightC_Workspace/zephyr/soc/espressif/Kconfig.soc"
osource "/media/tecna/disk11/linux/embedded-mcu/BrightC_Workspace/zephyr/soc/ene/kb1200/Kconfig.soc"
osource "/media/tecna/disk11/linux/embedded-mcu/BrightC_Workspace/zephyr/soc/ene/kb106x/Kconfig.soc"
osource "/media/tecna/disk11/linux/embedded-mcu/BrightC_Workspace/zephyr/soc/elan/em32f967/Kconfig.soc"
osource "/media/tecna/disk11/linux/embedded-mcu/BrightC_Workspace/zephyr/soc/egis/Kconfig.soc"
osource "/media/tecna/disk11/linux/embedded-mcu/BrightC_Workspace/zephyr/soc/efinix/sapphire/Kconfig.soc"
osource "/media/tecna/disk11/linux/embedded-mcu/BrightC_Workspace/zephyr/soc/cdns/xtensa_sample_controller/Kconfig.soc"
osource "/media/tecna/disk11/linux/embedded-mcu/BrightC_Workspace/zephyr/soc/cdns/swerv/Kconfig.soc"
osource "/media/tecna/disk11/linux/embedded-mcu/BrightC_Workspace/zephyr/soc/cdns/sample_controller32/Kconfig.soc"
osource "/media/tecna/disk11/linux/embedded-mcu/BrightC_Workspace/zephyr/soc/cdns/dc233c/Kconfig.soc"
osource "/media/tecna/disk11/linux/embedded-mcu/BrightC_Workspace/zephyr/soc/cdac/Kconfig.soc"
osource "/media/tecna/disk11/linux/embedded-mcu/BrightC_Workspace/zephyr/soc/brcm/bcmvk/Kconfig.soc"
osource "/media/tecna/disk11/linux/embedded-mcu/BrightC_Workspace/zephyr/soc/brcm/bcm2712/Kconfig.soc"
osource "/media/tecna/disk11/linux/embedded-mcu/BrightC_Workspace/zephyr/soc/brcm/bcm2711/Kconfig.soc"
osource "/media/tecna/disk11/linux/embedded-mcu/BrightC_Workspace/zephyr/soc/brcm/bcm2710/Kconfig.soc"
osource "/media/tecna/disk11/linux/embedded-mcu/BrightC_Workspace/zephyr/soc/blackberry/qnxhv_vm/Kconfig.soc"
osource "/media/tecna/disk11/linux/embedded-mcu/BrightC_Workspace/zephyr/soc/bflb/Kconfig.soc"
osource "/media/tecna/disk11/linux/embedded-mcu/BrightC_Workspace/zephyr/soc/atmel/sam0/Kconfig.soc"
osource "/media/tecna/disk11/linux/embedded-mcu/BrightC_Workspace/zephyr/soc/atmel/sam/Kconfig.soc"
osource "/media/tecna/disk11/linux/embedded-mcu/BrightC_Workspace/zephyr/soc/aspeed/Kconfig.soc"
osource "/media/tecna/disk11/linux/embedded-mcu/BrightC_Workspace/zephyr/soc/arm/Kconfig.soc"
osource "/media/tecna/disk11/linux/embedded-mcu/BrightC_Workspace/zephyr/soc/antmicro/myra/Kconfig.soc"
osource "/media/tecna/disk11/linux/embedded-mcu/BrightC_Workspace/zephyr/soc/andestech/Kconfig.soc"
osource "/media/tecna/disk11/linux/embedded-mcu/BrightC_Workspace/zephyr/soc/amd/acp_7_x/Kconfig.soc"
osource "/media/tecna/disk11/linux/embedded-mcu/BrightC_Workspace/zephyr/soc/amd/acp_7_0/Kconfig.soc"
osource "/media/tecna/disk11/linux/embedded-mcu/BrightC_Workspace/zephyr/soc/amd/acp_6_0/Kconfig.soc"
osource "/media/tecna/disk11/linux/embedded-mcu/BrightC_Workspace/zephyr/soc/ambiq/Kconfig.soc"
osource "/media/tecna/disk11/linux/embedded-mcu/BrightC_Workspace/zephyr/soc/allwinner/sun8i_h3/Kconfig.soc"
osource "/media/tecna/disk11/linux/embedded-mcu/BrightC_Workspace/zephyr/soc/allwinner/sun50i_h618/Kconfig.soc"
osource "/media/tecna/disk11/linux/embedded-mcu/BrightC_Workspace/zephyr/soc/alif/ensemble/Kconfig.soc"
osource "/media/tecna/disk11/linux/embedded-mcu/BrightC_Workspace/zephyr/soc/alif/balletto/Kconfig.soc"
osource "/media/tecna/disk11/linux/embedded-mcu/BrightC_Workspace/zephyr/soc/aesc/Kconfig.soc"
osource "/media/tecna/disk11/linux/embedded-mcu/BrightC_Workspace/zephyr/soc/adi/max32/Kconfig.soc"
```
