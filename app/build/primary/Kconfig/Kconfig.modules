## app/build/primary/Kconfig/soc/Kconfig
```kconfig
# Load Zephyr SoC Kconfig descriptions.
osource "/media/tecna/disk11/linux/embedded-mcu/BrightC_Workspace/zephyr/soc/xlnx/zynqmp/Kconfig"
osource "/media/tecna/disk11/linux/embedded-mcu/BrightC_Workspace/zephyr/soc/xlnx/zynq7000/Kconfig"
osource "/media/tecna/disk11/linux/embedded-mcu/BrightC_Workspace/zephyr/soc/xlnx/versalnet/Kconfig"
osource "/media/tecna/disk11/linux/embedded-mcu/BrightC_Workspace/zephyr/soc/xlnx/versal2/Kconfig"
osource "/media/tecna/disk11/linux/embedded-mcu/BrightC_Workspace/zephyr/soc/xlnx/versal/Kconfig"
osource "/media/tecna/disk11/linux/embedded-mcu/BrightC_Workspace/zephyr/soc/xen/Kconfig"
osource "/media/tecna/disk11/linux/embedded-mcu/BrightC_Workspace/zephyr/soc/wch/ch32v/Kconfig"
osource "/media/tecna/disk11/linux/embedded-mcu/BrightC_Workspace/zephyr/soc/ti/tiva_c/Kconfig"
osource "/media/tecna/disk11/linux/embedded-mcu/BrightC_Workspace/zephyr/soc/ti/simplelink/Kconfig"
osource "/media/tecna/disk11/linux/embedded-mcu/BrightC_Workspace/zephyr/soc/ti/mspm/Kconfig"
osource "/media/tecna/disk11/linux/embedded-mcu/BrightC_Workspace/zephyr/soc/ti/lm3s6965/Kconfig"
osource "/media/tecna/disk11/linux/embedded-mcu/BrightC_Workspace/zephyr/soc/ti/k3/Kconfig"
osource "/media/tecna/disk11/linux/embedded-mcu/BrightC_Workspace/zephyr/soc/ti/am13/Kconfig"
osource "/media/tecna/disk11/linux/embedded-mcu/BrightC_Workspace/zephyr/soc/telink/tlsr/Kconfig"
osource "/media/tecna/disk11/linux/embedded-mcu/BrightC_Workspace/zephyr/soc/syna/sr100/Kconfig"
osource "/media/tecna/disk11/linux/embedded-mcu/BrightC_Workspace/zephyr/soc/starfive/jh71xx/Kconfig"
osource "/media/tecna/disk11/linux/embedded-mcu/BrightC_Workspace/zephyr/soc/st/stm32/Kconfig"
osource "/media/tecna/disk11/linux/embedded-mcu/BrightC_Workspace/zephyr/soc/snps/qemu_arc/Kconfig"
osource "/media/tecna/disk11/linux/embedded-mcu/BrightC_Workspace/zephyr/soc/snps/nsim/arc_v/Kconfig"
osource "/media/tecna/disk11/linux/embedded-mcu/BrightC_Workspace/zephyr/soc/snps/nsim/arc_classic/Kconfig"
osource "/media/tecna/disk11/linux/embedded-mcu/BrightC_Workspace/zephyr/soc/snps/hsdk4xd/Kconfig"
osource "/media/tecna/disk11/linux/embedded-mcu/BrightC_Workspace/zephyr/soc/snps/hsdk/Kconfig"
osource "/media/tecna/disk11/linux/embedded-mcu/BrightC_Workspace/zephyr/soc/snps/emsk/Kconfig"
osource "/media/tecna/disk11/linux/embedded-mcu/BrightC_Workspace/zephyr/soc/snps/emsdp/Kconfig"
osource "/media/tecna/disk11/linux/embedded-mcu/BrightC_Workspace/zephyr/soc/snps/arc_iot/Kconfig"
osource "/media/tecna/disk11/linux/embedded-mcu/BrightC_Workspace/zephyr/soc/silabs/Kconfig"
osource "/media/tecna/disk11/linux/embedded-mcu/BrightC_Workspace/zephyr/soc/sifli/sf32/Kconfig"
osource "/media/tecna/disk11/linux/embedded-mcu/BrightC_Workspace/zephyr/soc/sifive/sifive_freedom/Kconfig"
osource "/media/tecna/disk11/linux/embedded-mcu/BrightC_Workspace/zephyr/soc/shakti/Kconfig"
osource "/media/tecna/disk11/linux/embedded-mcu/BrightC_Workspace/zephyr/soc/sensry/Kconfig"
osource "/media/tecna/disk11/linux/embedded-mcu/BrightC_Workspace/zephyr/soc/rockchip/Kconfig"
osource "/media/tecna/disk11/linux/embedded-mcu/BrightC_Workspace/zephyr/soc/renode/riscv_virtual/Kconfig"
osource "/media/tecna/disk11/linux/embedded-mcu/BrightC_Workspace/zephyr/soc/renode/cortex_r8_virtual/Kconfig"
osource "/media/tecna/disk11/linux/embedded-mcu/BrightC_Workspace/zephyr/soc/renesas/smartbond/Kconfig"
osource "/media/tecna/disk11/linux/embedded-mcu/BrightC_Workspace/zephyr/soc/renesas/rz/Kconfig"
osource "/media/tecna/disk11/linux/embedded-mcu/BrightC_Workspace/zephyr/soc/renesas/rx/Kconfig"
osource "/media/tecna/disk11/linux/embedded-mcu/BrightC_Workspace/zephyr/soc/renesas/rcar/Kconfig"
osource "/media/tecna/disk11/linux/embedded-mcu/BrightC_Workspace/zephyr/soc/renesas/ra/Kconfig"
osource "/media/tecna/disk11/linux/embedded-mcu/BrightC_Workspace/zephyr/soc/realtek/fingerprint/Kconfig"
osource "/media/tecna/disk11/linux/embedded-mcu/BrightC_Workspace/zephyr/soc/realtek/ec/Kconfig"
osource "/media/tecna/disk11/linux/embedded-mcu/BrightC_Workspace/zephyr/soc/realtek/bee/Kconfig"
osource "/media/tecna/disk11/linux/embedded-mcu/BrightC_Workspace/zephyr/soc/realtek/ameba/Kconfig"
osource "/media/tecna/disk11/linux/embedded-mcu/BrightC_Workspace/zephyr/soc/raspberrypi/rpi_pico/Kconfig"
osource "/media/tecna/disk11/linux/embedded-mcu/BrightC_Workspace/zephyr/soc/quicklogic/eos_s3/Kconfig"
osource "/media/tecna/disk11/linux/embedded-mcu/BrightC_Workspace/zephyr/soc/qemu/virt_riscv/Kconfig"
osource "/media/tecna/disk11/linux/embedded-mcu/BrightC_Workspace/zephyr/soc/qemu/tricore/Kconfig"
osource "/media/tecna/disk11/linux/embedded-mcu/BrightC_Workspace/zephyr/soc/qemu/or1k/Kconfig"
osource "/media/tecna/disk11/linux/embedded-mcu/BrightC_Workspace/zephyr/soc/qemu/malta/Kconfig"
osource "/media/tecna/disk11/linux/embedded-mcu/BrightC_Workspace/zephyr/soc/qemu/hexagon/Kconfig"
osource "/media/tecna/disk11/linux/embedded-mcu/BrightC_Workspace/zephyr/soc/openisa/rv32m1/Kconfig"
osource "/media/tecna/disk11/linux/embedded-mcu/BrightC_Workspace/zephyr/soc/openhwgroup/cva6/Kconfig"
osource "/media/tecna/disk11/linux/embedded-mcu/BrightC_Workspace/zephyr/soc/oct/osd32mp15x/Kconfig"
osource "/media/tecna/disk11/linux/embedded-mcu/BrightC_Workspace/zephyr/soc/nxp/s32/Kconfig"
osource "/media/tecna/disk11/linux/embedded-mcu/BrightC_Workspace/zephyr/soc/nxp/rw/Kconfig"
osource "/media/tecna/disk11/linux/embedded-mcu/BrightC_Workspace/zephyr/soc/nxp/mcx/Kconfig"
osource "/media/tecna/disk11/linux/embedded-mcu/BrightC_Workspace/zephyr/soc/nxp/lpc/Kconfig"
osource "/media/tecna/disk11/linux/embedded-mcu/BrightC_Workspace/zephyr/soc/nxp/layerscape/Kconfig"
osource "/media/tecna/disk11/linux/embedded-mcu/BrightC_Workspace/zephyr/soc/nxp/kinetis/Kconfig"
osource "/media/tecna/disk11/linux/embedded-mcu/BrightC_Workspace/zephyr/soc/nxp/imxrt/Kconfig"
osource "/media/tecna/disk11/linux/embedded-mcu/BrightC_Workspace/zephyr/soc/nxp/imx/Kconfig"
osource "/media/tecna/disk11/linux/embedded-mcu/BrightC_Workspace/zephyr/soc/nuvoton/numicro/Kconfig"
osource "/media/tecna/disk11/linux/embedded-mcu/BrightC_Workspace/zephyr/soc/nuvoton/numaker/Kconfig"
osource "/media/tecna/disk11/linux/embedded-mcu/BrightC_Workspace/zephyr/soc/nuvoton/npcx/Kconfig"
osource "/media/tecna/disk11/linux/embedded-mcu/BrightC_Workspace/zephyr/soc/nuvoton/npcm/Kconfig"
osource "/media/tecna/disk11/linux/embedded-mcu/BrightC_Workspace/zephyr/soc/nordic/Kconfig"
osource "/media/tecna/disk11/linux/embedded-mcu/BrightC_Workspace/zephyr/soc/neorv32/Kconfig"
osource "/media/tecna/disk11/linux/embedded-mcu/BrightC_Workspace/zephyr/soc/native/inf_clock/Kconfig"
osource "/media/tecna/disk11/linux/embedded-mcu/BrightC_Workspace/zephyr/soc/microchip/smartfusion2/Kconfig"
osource "/media/tecna/disk11/linux/embedded-mcu/BrightC_Workspace/zephyr/soc/microchip/sam/sama7/Kconfig"
osource "/media/tecna/disk11/linux/embedded-mcu/BrightC_Workspace/zephyr/soc/microchip/sam/sama5/Kconfig"
osource "/media/tecna/disk11/linux/embedded-mcu/BrightC_Workspace/zephyr/soc/microchip/sam/sam_d5x_e5x/Kconfig"
osource "/media/tecna/disk11/linux/embedded-mcu/BrightC_Workspace/zephyr/soc/microchip/pic64/Kconfig"
osource "/media/tecna/disk11/linux/embedded-mcu/BrightC_Workspace/zephyr/soc/microchip/pic32c/pic32cz_ca/Kconfig"
osource "/media/tecna/disk11/linux/embedded-mcu/BrightC_Workspace/zephyr/soc/microchip/pic32c/pic32cx_sg/Kconfig"
osource "/media/tecna/disk11/linux/embedded-mcu/BrightC_Workspace/zephyr/soc/microchip/pic32c/pic32cm_sg_gc/Kconfig"
osource "/media/tecna/disk11/linux/embedded-mcu/BrightC_Workspace/zephyr/soc/microchip/pic32c/pic32cm_pl/Kconfig"
osource "/media/tecna/disk11/linux/embedded-mcu/BrightC_Workspace/zephyr/soc/microchip/pic32c/pic32cm_jh/Kconfig"
osource "/media/tecna/disk11/linux/embedded-mcu/BrightC_Workspace/zephyr/soc/microchip/pic32c/pic32ck_sg_gc/Kconfig"
osource "/media/tecna/disk11/linux/embedded-mcu/BrightC_Workspace/zephyr/soc/microchip/miv/Kconfig"
osource "/media/tecna/disk11/linux/embedded-mcu/BrightC_Workspace/zephyr/soc/microchip/mec/Kconfig"
osource "/media/tecna/disk11/linux/embedded-mcu/BrightC_Workspace/zephyr/soc/mediatek/mt8xxx/Kconfig"
osource "/media/tecna/disk11/linux/embedded-mcu/BrightC_Workspace/zephyr/soc/lowrisc/opentitan/Kconfig"
osource "/media/tecna/disk11/linux/embedded-mcu/BrightC_Workspace/zephyr/soc/litex/Kconfig"
osource "/media/tecna/disk11/linux/embedded-mcu/BrightC_Workspace/zephyr/soc/ite/ec/Kconfig"
osource "/media/tecna/disk11/linux/embedded-mcu/BrightC_Workspace/zephyr/soc/intel/wildcat_lake/Kconfig"
osource "/media/tecna/disk11/linux/embedded-mcu/BrightC_Workspace/zephyr/soc/intel/raptor_lake/Kconfig"
osource "/media/tecna/disk11/linux/embedded-mcu/BrightC_Workspace/zephyr/soc/intel/panther_lake/Kconfig"
osource "/media/tecna/disk11/linux/embedded-mcu/BrightC_Workspace/zephyr/soc/intel/nova_lake/Kconfig"
osource "/media/tecna/disk11/linux/embedded-mcu/BrightC_Workspace/zephyr/soc/intel/lakemont/Kconfig"
osource "/media/tecna/disk11/linux/embedded-mcu/BrightC_Workspace/zephyr/soc/intel/intel_socfpga_std/Kconfig"
osource "/media/tecna/disk11/linux/embedded-mcu/BrightC_Workspace/zephyr/soc/intel/intel_socfpga/Kconfig"
osource "/media/tecna/disk11/linux/embedded-mcu/BrightC_Workspace/zephyr/soc/intel/intel_niosv/Kconfig"
osource "/media/tecna/disk11/linux/embedded-mcu/BrightC_Workspace/zephyr/soc/intel/intel_ish/Kconfig"
osource "/media/tecna/disk11/linux/embedded-mcu/BrightC_Workspace/zephyr/soc/intel/intel_adsp/Kconfig"
osource "/media/tecna/disk11/linux/embedded-mcu/BrightC_Workspace/zephyr/soc/intel/elkhart_lake/Kconfig"
osource "/media/tecna/disk11/linux/embedded-mcu/BrightC_Workspace/zephyr/soc/intel/atom/Kconfig"
osource "/media/tecna/disk11/linux/embedded-mcu/BrightC_Workspace/zephyr/soc/intel/apollo_lake/Kconfig"
osource "/media/tecna/disk11/linux/embedded-mcu/BrightC_Workspace/zephyr/soc/intel/alder_lake/Kconfig"
osource "/media/tecna/disk11/linux/embedded-mcu/BrightC_Workspace/zephyr/soc/infineon/psoc4/Kconfig"
osource "/media/tecna/disk11/linux/embedded-mcu/BrightC_Workspace/zephyr/soc/infineon/edge/Kconfig"
osource "/media/tecna/disk11/linux/embedded-mcu/BrightC_Workspace/zephyr/soc/infineon/cat3/Kconfig"
osource "/media/tecna/disk11/linux/embedded-mcu/BrightC_Workspace/zephyr/soc/infineon/cat1c/Kconfig"
osource "/media/tecna/disk11/linux/embedded-mcu/BrightC_Workspace/zephyr/soc/infineon/cat1b/Kconfig"
osource "/media/tecna/disk11/linux/embedded-mcu/BrightC_Workspace/zephyr/soc/infineon/cat1a/Kconfig"
osource "/media/tecna/disk11/linux/embedded-mcu/BrightC_Workspace/zephyr/soc/gd/gd32/Kconfig"
osource "/media/tecna/disk11/linux/embedded-mcu/BrightC_Workspace/zephyr/soc/gaisler/leon3/Kconfig"
osource "/media/tecna/disk11/linux/embedded-mcu/BrightC_Workspace/zephyr/soc/gaisler/gr716a/Kconfig"
osource "/media/tecna/disk11/linux/embedded-mcu/BrightC_Workspace/zephyr/soc/focaltech/Kconfig"
osource "/media/tecna/disk11/linux/embedded-mcu/BrightC_Workspace/zephyr/soc/espressif/Kconfig"
osource "/media/tecna/disk11/linux/embedded-mcu/BrightC_Workspace/zephyr/soc/ene/kb1200/Kconfig"
osource "/media/tecna/disk11/linux/embedded-mcu/BrightC_Workspace/zephyr/soc/ene/kb106x/Kconfig"
osource "/media/tecna/disk11/linux/embedded-mcu/BrightC_Workspace/zephyr/soc/elan/em32f967/Kconfig"
osource "/media/tecna/disk11/linux/embedded-mcu/BrightC_Workspace/zephyr/soc/egis/Kconfig"
osource "/media/tecna/disk11/linux/embedded-mcu/BrightC_Workspace/zephyr/soc/efinix/sapphire/Kconfig"
osource "/media/tecna/disk11/linux/embedded-mcu/BrightC_Workspace/zephyr/soc/cdns/xtensa_sample_controller/Kconfig"
osource "/media/tecna/disk11/linux/embedded-mcu/BrightC_Workspace/zephyr/soc/cdns/swerv/Kconfig"
osource "/media/tecna/disk11/linux/embedded-mcu/BrightC_Workspace/zephyr/soc/cdns/sample_controller32/Kconfig"
osource "/media/tecna/disk11/linux/embedded-mcu/BrightC_Workspace/zephyr/soc/cdns/dc233c/Kconfig"
osource "/media/tecna/disk11/linux/embedded-mcu/BrightC_Workspace/zephyr/soc/cdac/Kconfig"
osource "/media/tecna/disk11/linux/embedded-mcu/BrightC_Workspace/zephyr/soc/brcm/bcmvk/Kconfig"
osource "/media/tecna/disk11/linux/embedded-mcu/BrightC_Workspace/zephyr/soc/brcm/bcm2712/Kconfig"
osource "/media/tecna/disk11/linux/embedded-mcu/BrightC_Workspace/zephyr/soc/brcm/bcm2711/Kconfig"
osource "/media/tecna/disk11/linux/embedded-mcu/BrightC_Workspace/zephyr/soc/brcm/bcm2710/Kconfig"
osource "/media/tecna/disk11/linux/embedded-mcu/BrightC_Workspace/zephyr/soc/blackberry/qnxhv_vm/Kconfig"
osource "/media/tecna/disk11/linux/embedded-mcu/BrightC_Workspace/zephyr/soc/bflb/Kconfig"
osource "/media/tecna/disk11/linux/embedded-mcu/BrightC_Workspace/zephyr/soc/atmel/sam0/Kconfig"
osource "/media/tecna/disk11/linux/embedded-mcu/BrightC_Workspace/zephyr/soc/atmel/sam/Kconfig"
osource "/media/tecna/disk11/linux/embedded-mcu/BrightC_Workspace/zephyr/soc/aspeed/Kconfig"
osource "/media/tecna/disk11/linux/embedded-mcu/BrightC_Workspace/zephyr/soc/arm/Kconfig"
osource "/media/tecna/disk11/linux/embedded-mcu/BrightC_Workspace/zephyr/soc/antmicro/myra/Kconfig"
osource "/media/tecna/disk11/linux/embedded-mcu/BrightC_Workspace/zephyr/soc/andestech/Kconfig"
osource "/media/tecna/disk11/linux/embedded-mcu/BrightC_Workspace/zephyr/soc/amd/acp_7_x/Kconfig"
osource "/media/tecna/disk11/linux/embedded-mcu/BrightC_Workspace/zephyr/soc/amd/acp_7_0/Kconfig"
osource "/media/tecna/disk11/linux/embedded-mcu/BrightC_Workspace/zephyr/soc/amd/acp_6_0/Kconfig"
osource "/media/tecna/disk11/linux/embedded-mcu/BrightC_Workspace/zephyr/soc/ambiq/Kconfig"
osource "/media/tecna/disk11/linux/embedded-mcu/BrightC_Workspace/zephyr/soc/allwinner/sun8i_h3/Kconfig"
osource "/media/tecna/disk11/linux/embedded-mcu/BrightC_Workspace/zephyr/soc/allwinner/sun50i_h618/Kconfig"
osource "/media/tecna/disk11/linux/embedded-mcu/BrightC_Workspace/zephyr/soc/alif/ensemble/Kconfig"
osource "/media/tecna/disk11/linux/embedded-mcu/BrightC_Workspace/zephyr/soc/alif/balletto/Kconfig"
osource "/media/tecna/disk11/linux/embedded-mcu/BrightC_Workspace/zephyr/soc/aesc/Kconfig"
osource "/media/tecna/disk11/linux/embedded-mcu/BrightC_Workspace/zephyr/soc/adi/max32/Kconfig"
```
